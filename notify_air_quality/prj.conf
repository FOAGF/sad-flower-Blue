## CMakeLists.txt
```
# SPDX-License-Identifier: Apache-2.0

cmake_minimum_required(VERSION 3.20.0)
find_package(Zephyr REQUIRED HINTS $ENV{ZEPHYR_BASE})
project(peripheral)

target_sources(app PRIVATE
  src/main.c
  src/aq_service.c
  src/blinky_led.c
)
```

## prj.conf
```kconfig
CONFIG_BT=y
CONFIG_BT_PERIPHERAL=y
CONFIG_BT_DIS=y
CONFIG_BT_DEVICE_NAME="Air Quality Sensor"
CONFIG_BT_DEVICE_APPEARANCE=833


CONFIG_I2C=y
CONFIG_SENSOR=y
```

## src/main.c
```c
/* main.c - Application main entry point */

/*
 * Copyright (c) 2015-2016 Intel Corporation
 *
 * SPDX-License-Identifier: Apache-2.0
 */

#include <zephyr/kernel.h>
#include <zephyr/bluetooth/bluetooth.h>
#include <zephyr/bluetooth/gatt.h>
#include <zephyr/drivers/gpio.h>

#include "aq_service.h"

// ----------------- LED  ----------------- 
/* The devicetree node identifiers for the red green and blue alias'. */
#define LED_RED DT_ALIAS(led0)
#define LED_GREEN DT_ALIAS(led1)
#define LED_BLUE DT_ALIAS(led2)

static const struct gpio_dt_spec led_red = GPIO_DT_SPEC_GET(LED_RED, gpios);
static const struct gpio_dt_spec led_green = GPIO_DT_SPEC_GET(LED_GREEN, gpios);
static const struct gpio_dt_spec led_blue = GPIO_DT_SPEC_GET(LED_BLUE, gpios);

#define LED_BLINK_THREAD_SIZE 1000
#define LED_BLINK_THREAD_PRIORITY 10

static void led_thread(void *, void *, void *);

K_THREAD_DEFINE(led_blink_thread_id, LED_BLINK_THREAD_SIZE,
                led_thread, NULL, NULL, NULL,
                LED_BLINK_THREAD_PRIORITY, 0, 0);

// -----------------  END LED  ----------------- 

static const struct bt_data ad[] = {
	BT_DATA_BYTES(BT_DATA_FLAGS, (BT_LE_AD_GENERAL | BT_LE_AD_NO_BREDR)),
	BT_DATA_BYTES(BT_DATA_UUID16_ALL,
		      BT_UUID_16_ENCODE(BT_UUID_CTS_VAL)),
};

static void connected(struct bt_conn *conn, uint8_t err)
{
	if (err) {
		printk("Connection failed (err 0x%02x)\n", err);
	} else {
		printk("Connected\n");
	}
}

static void disconnected(struct bt_conn *conn, uint8_t reason)
{
	printk("Disconnected (reason 0x%02x)\n", reason);
}

BT_CONN_CB_DEFINE(conn_callbacks) = {
	.connected = connected,
	.disconnected = disconnected,
};

static void bt_ready(void)
{
	int err;

	printk("Bluetooth initialized\n");

	aqs_init();

	err = bt_le_adv_start(BT_LE_ADV_CONN_NAME, ad, ARRAY_SIZE(ad), NULL, 0);
	if (err) {
		printk("Advertising failed to start (err %d)\n", err);
		return;
	}

	printk("Advertising successfully started\n");
}


void main(void)
{

	int err;

	err = bt_enable(NULL);
	if (err) {
		printk("Bluetooth init failed (err %d)\n", err);
		return;
	}

	bt_ready();

	//Implement notification.
	while (1) {
		k_sleep(K_SECONDS(1));
		/* Air Quality Service updates only when new value is read */
		aqs_notify();
	}
}



				
// -----------------  LED  ----------------- 

// Initialise an led from device tree spec
static bool initGpio(const struct gpio_dt_spec *led_dt)
{

	if (!gpio_is_ready_dt(led_dt))
	{
		return true;
	}

	if (gpio_pin_configure_dt(led_dt, GPIO_OUTPUT_ACTIVE) < 0)
	{
		return true;
	}

	gpio_pin_set_dt(led_dt, 0);

	return false;
}


// blinks led every second, signifies mobile node is running
static void led_thread(void *, void *, void *) {

	if (initGpio(&led_red) || initGpio(&led_green) || initGpio(&led_blue))
	{
		return;
	}

	while (1)
	{
		gpio_pin_toggle_dt(&led_red);
		k_sleep(K_MSEC(1000));
	}
}
			
// -----------------  END LED  ----------------- 
```

## src/aq_service.c
```c
/** @file
 *  @brief CTS Service sample
 */

/*
 * Copyright (c) 2016 Intel Corporation
 *
 * SPDX-License-Identifier: Apache-2.0
 */

#include <zephyr/types.h>
#include <stddef.h>
#include <string.h>
#include <stdio.h>
#include <errno.h>
#include <zephyr/sys/printk.h>
#include <zephyr/sys/byteorder.h>
#include <zephyr/kernel.h>

#include <zephyr/bluetooth/bluetooth.h>
#include <zephyr/bluetooth/hci.h>
#include <zephyr/bluetooth/conn.h>
#include <zephyr/bluetooth/uuid.h>
#include <zephyr/bluetooth/gatt.h>

#include <zephyr/drivers/sensor.h>
#include <zephyr/drivers/sensor/ccs811.h>

#include "aq_service.h"

#define AQS_THREAD_SIZE 1000
#define AQS_THREAD_PRIORITY 5

static void aqs_thread(void *, void *, void *);

K_THREAD_DEFINE(aqs_thread_id, AQS_THREAD_SIZE,
                aqs_thread, NULL, NULL, NULL,
                AQS_THREAD_PRIORITY, 0, 0);


static uint8_t aq[2];

static void aq_ccc_cfg_changed(const struct bt_gatt_attr *attr, uint16_t value)
{
	/* TODO: Handle value */
}

static ssize_t read_aq(struct bt_conn *conn, const struct bt_gatt_attr *attr,
		       void *buf, uint16_t len, uint16_t offset)
{
	return bt_gatt_attr_read(conn, attr, buf, len, offset, aq ,
				 sizeof(aq));
}

/* Current Time Service Declaration */
BT_GATT_SERVICE_DEFINE(aqs_cvs,
	BT_GATT_PRIMARY_SERVICE(&aqs_service_uuid),
	BT_GATT_CHARACTERISTIC(&aqs_notify_uuid.uuid, BT_GATT_CHRC_READ |
			       BT_GATT_CHRC_NOTIFY,
			       BT_GATT_PERM_READ,
			       read_aq, NULL, aq),
	BT_GATT_CCC(aq_ccc_cfg_changed, BT_GATT_PERM_READ),
);


void aqs_init(void)
{
	// do nothing (start thread)
}

void aqs_notify(void)
{	

	bt_gatt_notify(NULL, &aqs_cvs.attrs[1], &aq, sizeof(aq));
}

static bool app_fw_2;

static const char *now_str(void)
{
	static char buf[16]; /* ...HH:MM:SS.MMM */
	uint32_t now = k_uptime_get_32();
	unsigned int ms = now % MSEC_PER_SEC;
	unsigned int s;
	unsigned int min;
	unsigned int h;

	now /= MSEC_PER_SEC;
	s = now % 60U;
	now /= 60U;
	min = now % 60U;
	now /= 60U;
	h = now;

	snprintf(buf, sizeof(buf), "%u:%02u:%02u.%03u",
		 h, min, s, ms);
	return buf;
}

static int do_fetch(const struct device *dev)
{
	struct sensor_value co2, tvoc, voltage, current;
	int rc = 0;

	if (rc == 0) {
		rc = sensor_sample_fetch(dev);
	}
	if (rc == 0) {
		const struct ccs811_result_type *rp = ccs811_result(dev);

		sensor_channel_get(dev, SENSOR_CHAN_CO2, &co2);
		sensor_channel_get(dev, SENSOR_CHAN_VOC, &tvoc);
		sensor_channel_get(dev, SENSOR_CHAN_VOLTAGE, &voltage);
		sensor_channel_get(dev, SENSOR_CHAN_CURRENT, &current);
		printk("\n[%s]: CCS811: %u ppm eCO2; %u ppb eTVOC\n",
		       now_str(), co2.val1, tvoc.val1);
		printk("Voltage: %d.%06dV; Current: %d.%06dA\n", voltage.val1,
		       voltage.val2, current.val1, current.val2);

		if (app_fw_2 && !(rp->status & CCS811_STATUS_DATA_READY)) {
			printk("STALE DATA\n");
		}

		if (rp->status & CCS811_STATUS_ERROR) {
			printk("ERROR: %02x\n", rp->error);
		}
		
		aq[0] = (uint8_t) (co2.val1 >> 0);
		aq[1] = (uint8_t) (co2.val1 >> 8);
	}
	return rc;
}


static void fetch_value(const struct device *dev)
{
	
	int rc = do_fetch(dev);

	if (rc == 0) {
		printk("Timed fetch got %d\n", rc);
	} else if (-EAGAIN == rc) {
		printk("Timed fetch got stale data\n");
	} else {
		printk("Timed fetch failed: %d\n", rc);
	}
}


// Initilises air quality sensor and updates every second
static void aqs_thread(void *, void *, void *) {

	const struct device *const dev = DEVICE_DT_GET_ONE(ams_ccs811);
	struct ccs811_configver_type cfgver;
	int rc;

	if (!device_is_ready(dev)) {
		printk("Device %s is not ready\n", dev->name);
		return;
	}

	printk("device is %p, name is %s\n", dev, dev->name);

	rc = ccs811_configver_fetch(dev, &cfgver);
	if (rc == 0) {
		printk("HW %02x; FW Boot %04x App %04x ; mode %02x\n",
		       cfgver.hw_version, cfgver.fw_boot_version,
		       cfgver.fw_app_version, cfgver.mode);
		app_fw_2 = (cfgver.fw_app_version >> 8) > 0x11;
	}


	while (1)
	{
		fetch_value(dev);
		k_sleep(K_MSEC(1000));
	}
}
```

## src/aq_service.h
```c
#ifndef AQ_SERVICE_H
#define AQ_SERVICE_H


#define BT_UUID_AIR_QUALITY_SERVICE \
	BT_UUID_128_ENCODE(0xc55e4011, 0xc55e, 0x4011, 0x0000, 0xc55e40110001)

#define BT_UUID_AIR_QUALITY_CO2 \
	BT_UUID_128_ENCODE(0xc55e4011, 0xc55e, 0x4011, 0x0000, 0xc55e40110002)

#define BT_UUID_AIR_QUALITY_TVOC \
	BT_UUID_128_ENCODE(0xc55e4011, 0xc55e, 0x4011, 0x0000, 0xc55e40110003)

static struct bt_uuid_128 aqs_service_uuid = BT_UUID_INIT_128(
	BT_UUID_AIR_QUALITY_SERVICE);

static struct bt_uuid_128 aqs_co2 = BT_UUID_INIT_128(
	BT_UUID_AIR_QUALITY_CO2);

static struct bt_uuid_128 aqs_tvoc = BT_UUID_INIT_128(
	BT_UUID_AIR_QUALITY_TVOC);

void aqs_init(void);
void aqs_notify(void);

#endif
```

## src/blinky_led.c
```c
#include <zephyr/kernel.h>
#include <zephyr/drivers/gpio.h>

/* The devicetree node identifiers for the red green and blue alias'. */
#define LED_RED DT_ALIAS(led0)
#define LED_GREEN DT_ALIAS(led1)
#define LED_BLUE DT_ALIAS(led2)

static const struct gpio_dt_spec led_red = GPIO_DT_SPEC_GET(LED_RED, gpios);
static const struct gpio_dt_spec led_green = GPIO_DT_SPEC_GET(LED_GREEN, gpios);
static const struct gpio_dt_spec led_blue = GPIO_DT_SPEC_GET(LED_BLUE, gpios);

#define LED_BLINK_THREAD_SIZE 1000
#define LED_BLINK_THREAD_PRIORITY 10

static void led_thread(void *, void *, void *);

K_THREAD_DEFINE(led_blink_thread_id, LED_BLINK_THREAD_SIZE,
                led_thread, NULL, NULL, NULL,
                LED_BLINK_THREAD_PRIORITY, 0, 0);

// Initialise an led from device tree spec
static bool initGpio(const struct gpio_dt_spec *led_dt)
{

	if (!gpio_is_ready_dt(led_dt))
	{
		return true;
	}

	if (gpio_pin_configure_dt(led_dt, GPIO_OUTPUT_ACTIVE) < 0)
	{
		return true;
	}

	gpio_pin_set_dt(led_dt, 0);

	return false;
}


// Initilises all led's and blinks red led every second
static void led_thread(void *, void *, void *) {

	if (initGpio(&led_red) || initGpio(&led_green) || initGpio(&led_blue))
	{
		return;
	}

	while (1)
	{
		gpio_pin_toggle_dt(&led_red);
		k_sleep(K_MSEC(1000));
	}
}
```
